## config/boards/shields/kapoard/Kconfig.defconfig
```kconfig
# Copyright (c) 2020 The ZMK Contributors
# SPDX-License-Identifier: MIT

if SHIELD_KAPOARD

config ZMK_KEYBOARD_NAME
    default "kapoard"

endif
```
